## board/udoo/a62/Kconfig
```kconfig
if TARGET_A62

config SYS_BOARD
	default "a62"

config SYS_VENDOR
	default "udoo"

config SYS_SOC
	default "mx6"

config SYS_CONFIG_NAME
	default "mx6seco_a62_android"

endif
```

## board/udoo/b08/Kconfig
```kconfig
if TARGET_SECO_B08

config SYS_BOARD
	default "b08"

config SYS_VENDOR
	default "udoo"

config SYS_SOC
	default "mx6"

config SYS_CONFIG_NAME
	default "seco_b08"

endif
```

## board/udoo/quad_dual/Kconfig
```kconfig
if TARGET_UDOO_QDL

config SYS_VENDOR
	default "udoo"

config SYS_BOARD
	default "quad_dual"

config SYS_SOC
	default "mx6"

config SYS_CONFIG_NAME
	default "udoo_qdl"

endif
```

## board/udoo/udoo_neo/Kconfig
```kconfig
if TARGET_UDOO_NEO

config SYS_BOARD
	default "udoo_neo"

config SYS_VENDOR
	default "udoo"

config SYS_SOC
	default "mx6"

config SYS_CONFIG_NAME
	default "udoo_neo"

endif
```

## board/udoo/udoo_qd/Kconfig
```kconfig
if TARGET_UDOO_QD

config SYS_VENDOR
	default "udoo"

config SYS_BOARD
	default "udoo_qd"

config SYS_SOC
	default "mx6"

config SYS_CONFIG_NAME
	default "udoo_qd"

endif
```

## configs/mx6dl_a62_android_defconfig
```kconfig
CONFIG_SPL=y
CONFIG_SYS_EXTRA_OPTIONS="IMX_CONFIG=arch/arm/imx-common/spl_sd.cfg,MX6Q,DDR_SIZE=2,DDR_MB=1024,ANDROID_SUPPORT"
CONFIG_ARM=y
CONFIG_TARGET_A62=y
CONFIG_DM=y
CONFIG_DM_THERMAL=y
```

## configs/mx6qdl_a62_android_defconfig
```kconfig
# Android support for A62 Quad/Dual and DualLite/Solo boards with 1024 memory size
CONFIG_SPL=y
CONFIG_SYS_EXTRA_OPTIONS="IMX_CONFIG=arch/arm/imx-common/spl_sd.cfg,MX6QDL,DDR_SIZE=1024,ANDROID_SUPPORT"
CONFIG_ARM=y
CONFIG_TARGET_A62=y
CONFIG_DM=y
CONFIG_DM_THERMAL=y
```

## configs/udoo_neo_defconfig
```kconfig
CONFIG_SYS_EXTRA_OPTIONS="IMX_CONFIG=board/udoo/neo/imximage.cfg,MX6SX"
CONFIG_ARM=y
CONFIG_TARGET_UDOO_NEO=y
CONFIG_DM=y
CONFIG_DM_THERMAL=y
```

## configs/udoo_quad_defconfig
```kconfig
CONFIG_SYS_EXTRA_OPTIONS="IMX_CONFIG=board/udoo/quad_dual/udoo.cfg,MX6Q,DDR_MB=1024"
CONFIG_ARM=y
CONFIG_TARGET_UDOO_QDL=y
```
